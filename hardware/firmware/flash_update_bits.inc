;@@@@@@@@@@@@@@@@@@@@@@@@@@@@@@@@@@@@@@@@@@@@@@@@@@@@@@@@@@@@@@@@@@@@@@@@@@@@@
;@@                                                                         @@
;@@                                                                         @@
;@@ @@@@@  @       @@@    @@@   @   @                                       @@
;@@ @      @      @   @  @   @  @   @    FLASH ROM UPDATE LOADER            @@
;@@ @      @      @   @  @      @   @                                       @@
;@@ @@@@   @      @@@@@   @@@   @@@@@    1.0                                @@
;@@ @      @      @   @      @  @   @                                       @@
;@@ @      @      @   @  @   @  @   @                                       @@
;@@ @      @@@@@  @   @   @@@   @   @                                       @@
;@@                                                                         @@
;@@ Copyright (c) 2013 by Steven L. Willoughby, Aloha, Oregon, USA.  All    @@
;@@ Rights Reserved.                                                        @@
;@@@@@@@@@@@@@@@@@@@@@@@@@@@@@@@@@@@@@@@@@@@@@@@@@@@@@@@@@@@@@@@@@@@@@@@@@@@@@
;
; flash update module bit definitions, included by caller and the module
;
#include "flash_update_user.inc"
;	
